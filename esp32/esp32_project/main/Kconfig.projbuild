## esp32/esp32_project/main/Kconfig.projbuild
```kconfig
menu "Coexistence Forcing"
    config ESP32_WIFI_BT_COEXIST
        bool "WiFi/BT Coexistence"
        default y
        help
            Force-enable coexistence
endmenu
```

## esp32/esp32_project/sdkconfig.defaults
```kconfig
# Force-enable coexistence
CONFIG_ESP32_WIFI_BT_COEXIST=y
CONFIG_ESP_COEX_SW_COEXIST_ENABLE=y
```
